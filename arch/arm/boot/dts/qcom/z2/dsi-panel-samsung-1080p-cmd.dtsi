&mdss_mdp {
	dsi_samsung_1080_cmd: qcom,mdss_dsi_samsung_1080p_cmd {
				qcom,mdss-dsi-panel-name = "samsung 1080p cmd mode dsi panel";
				qcom,mdss-dsi-panel-type = "dsi_cmd_mode";
				qcom,mdss-dsi-panel-framerate = <0x3c>;
				qcom,mdss-dsi-panel-clockrate = <0x35a4e900>;
				qcom,mdss-dsi-virtual-channel-id = <0x0>;
				qcom,mdss-dsi-stream = <0x0>;
				qcom,mdss-dsi-panel-width = <0x438>;
				qcom,mdss-dsi-panel-height = <0x780>;
				qcom,mdss-dsi-h-front-porch = <0x1>;
				qcom,mdss-dsi-h-back-porch = <0x1>;
				qcom,mdss-dsi-h-pulse-width = <0x1>;
				qcom,mdss-dsi-h-sync-skew = <0x0>;
				qcom,mdss-dsi-v-back-porch = <0x4>;
				qcom,mdss-dsi-v-front-porch = <0x14>;
				qcom,mdss-dsi-v-pulse-width = <0x1>;
				qcom,mdss-dsi-h-left-border = <0x0>;
				qcom,mdss-dsi-h-right-border = <0x0>;
				qcom,mdss-dsi-v-top-border = <0x0>;
				qcom,mdss-dsi-v-bottom-border = <0x0>;
				qcom,mdss-dsi-bpp = <0x18>;
				qcom,mdss-dsi-underflow-color = <0xff>;
				qcom,mdss-dsi-border-color = <0x0>;
				qcom,mdss-dsi-reset-sequence = <0x1 0x1 0x0 0x2 0x1 0x1>;
				qcom,mdss-dsi-on-command = [05 01 00 00 14 00 01 11 15 01 00 00 00 00 02 35 00 23 01 00 00 00 00 03 fc 5a 5a 23 01 00 00 00 00 03 f4 00 01 23 01 00 00 00 00 03 fc a5 a5 05 01 00 00 10 00 01 29];
				qcom,mdss-dsi-off-command = [15 01 00 00 00 00 02 34 00 05 01 00 00 10 00 01 28 05 01 00 00 40 00 01 10];
				qcom,mdss-dsi-on-command-state = "dsi_lp_mode";
				qcom,mdss-dsi-off-command-state = "dsi_hs_mode";
				qcom,mdss-dsi-h-sync-pulse = <0x0>;
				qcom,mdss-dsi-traffic-mode = "burst_mode";
				qcom,mdss-dsi-bllp-eof-power-mode;
				qcom,mdss-dsi-bllp-power-mode;
				qcom,mdss-dsi-lane-0-state;
				qcom,mdss-dsi-lane-1-state;
				qcom,mdss-dsi-lane-2-state;
				qcom,mdss-dsi-lane-3-state;
				qcom,mdss-dsi-panel-timings = <0xc9302000 0x5c602432 0x27030400>;
				qcom,mdss-dsi-t-clk-post = <0xd>;
				qcom,mdss-dsi-t-clk-pre = <0x2e>;
				qcom,mdss-dsi-dma-trigger = "trigger_sw";
				qcom,mdss-dsi-mdp-trigger = "none";
				qcom,mdss-dsi-te-pin-select = <0x1>;
				qcom,mdss-dsi-wr-mem-start = <0x2c>;
				qcom,mdss-dsi-wr-mem-continue = <0x3c>;
				qcom,mdss-dsi-te-dcs-command = <0x1>;
				qcom,mdss-dsi-te-check-enable;
				qcom,mdss-dsi-te-using-te-pin;
				qcom,mdss-dsi-panel-status-command = [06 01 00 01 05 00 02 0a 08];
				qcom,mdss-dsi-panel-status-command-state = "dsi_lp_mode";
				qcom,mdss-dsi-panel-status-check-mode = "reg_read";
				qcom,mdss-dsi-panel-status-value = <0x9c>;
				qcom,mdss-pan-physical-width-dimension = <0x41>;
				qcom,mdss-pan-physical-height-dimension = <0x73>;
				qcom,mdss-dsi-panel-timings-phy-v2 = <0x221e0708 0x40304a0 0x221e0708 0x40304a0 0x221e0708 0x40304a0 0x221e0708 0x40304a0 0x22170708 0x40304a0>;
				qcom,mdss-dsi-bl-pmic-control-type = "bl_ctrl_dcs";
				qcom,mdss-dsi-bl-min-level = <0x1>;
				qcom,mdss-dsi-bl-max-level = <0xff>;
				qcom,cont-splash-enabled;
				qcom,panel-supply-entries = <0x1a>;
	};
};
