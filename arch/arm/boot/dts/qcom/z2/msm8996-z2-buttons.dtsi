&soc {
	gpio_keys {
		pinctrl-names = "tlmm_gpio_key_active", "tlmm_gpio_key_suspend";
		pinctrl-0 = <0x1fc>;
		pinctrl-1 = <0x1fd>;

		vol_up {
			gpios = <0x39 0x2 0x1>;
		};

		home {
			label = "home";
			gpios = <0x38 0x26 0x1>;
			linux,input-type = <0x1>;
			linux,code = <0x66>;
			gpio-key,wakeup;
			debounce-interval = <0xf>;
		};
	};
};
