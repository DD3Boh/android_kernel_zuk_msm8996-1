&soc {
	hall_switch {
		reg = <0x0 0x0>;
		compatible = "shenqi,hall_switch";
		interrupt-parent = <0x38>;
		interrupts = <0x7c 0x0>;
		shenqi,hall-irq-gpio = <0x38 0x7c 0x0>;
		ssc_vdd-supply = <0x2d>;
	};
};
